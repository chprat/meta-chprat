## sources/meta-chprat/conf/distro/velaos.conf
```bitbake
require conf/distro/poky.conf

DISTROOVERRIDES = "poky"
DISTRO = "velaos"
DISTRO_NAME = "Vela Linux OS Distribution"

DISTRO_FEATURES:append = " ${@bb.utils.contains('MACHINE_FEATURES', 'printing', ' pam', '', d)}"

DISTRO_FEATURES:append = " systemd"
VIRTUAL-RUNTIME_init_manager = "systemd"
DISTRO_FEATURES_BACKFILL_CONSIDERED = "sysvinit"

PREFERRED_PROVIDER_u-boot-fw-utils = "libubootenv"
```

## sources/meta-chprat/conf/layer.conf
```bitbake
# We have a conf and classes directory, add to BBPATH
BBPATH .= ":${LAYERDIR}"

# We have recipes-* directories, add to BBFILES
BBFILES += "${LAYERDIR}/recipes-*/*/*.bb \
            ${LAYERDIR}/recipes-*/*/*.bbappend"

BBFILE_COLLECTIONS += "meta-chprat"
BBFILE_PATTERN_meta-chprat = "^${LAYERDIR}/"
BBFILE_PRIORITY_meta-chprat = "6"

LAYERDEPENDS_meta-chprat = "core"
LAYERSERIES_COMPAT_meta-chprat = "honister"
```

## sources/meta-chprat/conf/machine/pyxis.inc
```bitbake
IMAGE_FSTYPES:remove = "tar.bz2"
IMAGE_FSTYPES:remove = "ext3"
IMAGE_FSTYPES:append = " ext4.gz"

# This setting is needed when enabling using RPI_USE_U_BOOT
# as otherwise the device won't boot up
ENABLE_UART = "1"

WKS_FILE = "swupdate-raspberrypi.wks"
```

## sources/meta-chprat/conf/machine/sculptor.conf
```bitbake
require conf/machine/raspberrypi0-2w-64.conf
require conf/machine/pyxis.inc
MACHINEOVERRIDES := "${@'${MACHINEOVERRIDES}'.replace(':${MACHINE}',':raspberrypi0-2w-64:${MACHINE}')}"

MACHINE_FEATURES:append = " 3d-printing"
```
